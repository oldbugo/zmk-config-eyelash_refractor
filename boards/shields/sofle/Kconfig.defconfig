## boards/shields/sofle/Kconfig.defconfig
```kconfig
if SHIELD_SOFLE_LEFT

config ZMK_KEYBOARD_NAME
    default "Sofle"

config ZMK_SPLIT_BLE
    default y

config ZMK_SPLIT_ROLE_CENTRAL
    default y

config ZMK_USB
    default y

config ZMK_WIDGET_LAYER_STATUS
    default y if ZMK_DISPLAY

config ZMK_WIDGET_BATTERY_STATUS
    default y if ZMK_DISPLAY

config ZMK_WIDGET_OUTPUT_STATUS
    default y if ZMK_DISPLAY

endif # SHIELD_SOFLE_LEFT

if SHIELD_SOFLE_RIGHT

config ZMK_KEYBOARD_NAME
    default "Sofle Right"

config ZMK_SPLIT_BLE
    default y

config ZMK_SPLIT_ROLE_CENTRAL
    default n

config ZMK_USB
    default n

endif # SHIELD_SOFLE_RIGHT

if SHIELD_SOFLE_LEFT || SHIELD_SOFLE_RIGHT

config ZMK_SPLIT
    default y

if ZMK_DISPLAY
    config ZMK_DISPLAY_STATUS_SCREEN
        bool "Status Screen"
        default y

choice ZMK_DISPLAY_WORK_QUEUE
    default ZMK_DISPLAY_WORK_QUEUE_DEDICATED

config ZMK_DISPLAY_WORK_QUEUE_DEDICATED
    bool "Dedicated"

endchoice

endif # ZMK_DISPLAY

config SERIAL
    default y if ZMK_USB

config USB_CDC_ACM
    default y if SERIAL

config UART_LINE_CTRL
    default y if USB_CDC_ACM

config USB_DEVICE_STACK
    default y

endif # SHIELD_SOFLE_LEFT || SHIELD_SOFLE_RIGHT
```

## boards/shields/sofle/Kconfig.shield
```kconfig
config SHIELD_SOFLE_LEFT
    def_bool $(shields_list_contains,sofle_left)
    select ZMK_SPLIT_BLE_ROLE_CENTRAL

config SHIELD_SOFLE_RIGHT
    def_bool $(shields_list_contains,sofle_right)
    select ZMK_SPLIT_BLE_ROLE_PERIPHERAL
```
